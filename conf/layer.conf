## conf/layer.conf
```bitbake
# We have a conf and classes directory, add to BBPATH
BBPATH =. "${LAYERDIR}:"

# We have recipes-* directories, add to BBFILES
BBFILES += "${LAYERDIR}/recipes-*/*/*.bb \
            ${LAYERDIR}/recipes-*/*/*.bbappend"

BBFILE_COLLECTIONS += "updater-riscv"
BBFILE_PATTERN_updater-riscv = "^${LAYERDIR}/"
BBFILE_PRIORITY_updater-riscv = "7"

LAYERDEPENDS_updater-riscv = "sota"
LAYERDEPENDS_updater-riscv += "riscv-layer"
LAYERSERIES_COMPAT_updater-riscv = "warrior"
```
